## main/Kconfig.projbuild
```kconfig
menu "Alexa Wake-on-LAN"

    config WOL_DEVICE_NAME
        string "Nombre inicial del dispositivo"
        default "Encender PC"
        help
            Nombre descriptivo mostrado en los logs. Alexa permite cambiar el
            nombre después del emparejamiento Matter.

    config WOL_TARGET_MAC
        string "MAC de la computadora"
        default ""
        help
            Dirección MAC del adaptador de red que recibirá el Magic Packet,
            con formato AA:BB:CC:DD:EE:FF.

    config WOL_UDP_PORT
        int "Puerto UDP Wake-on-LAN"
        default 9
        range 1 65535

    config WOL_REPEAT_COUNT
        int "Cantidad de Magic Packets"
        default 3
        range 1 10

    config WOL_REPEAT_DELAY_MS
        int "Pausa entre paquetes (ms)"
        default 100
        range 0 2000

    config WOL_NETWORK_WAIT_SECONDS
        int "Espera máxima por IPv4 (s)"
        default 20
        range 1 120

    config WOL_MOMENTARY_RESET_MS
        int "Tiempo para regresar el interruptor a OFF (ms)"
        default 1000
        range 100 10000
        help
            El dispositivo se comporta como un pulsador: Alexa lo enciende,
            se envía Wake-on-LAN y después vuelve automáticamente a apagado.

endmenu
```

## sdkconfig.defaults
```kconfig
CONFIG_IDF_TARGET="esp32c3"
CONFIG_ESPTOOLPY_FLASHSIZE_4MB=y
CONFIG_ESP_DEFAULT_CPU_FREQ_MHZ_160=y

# Matter over Wi-Fi with BLE used only for initial commissioning.
CONFIG_BT_ENABLED=y
CONFIG_BT_NIMBLE_ENABLED=y
CONFIG_BT_NIMBLE_ENABLE_CONN_REATTEMPT=n
CONFIG_ENABLE_CHIPOBLE=y
CONFIG_USE_BLE_ONLY_FOR_COMMISSIONING=y
CONFIG_ENABLE_WIFI_STATION=y
CONFIG_ESP_WIFI_SOFTAP_SUPPORT=n
CONFIG_BLE_DEVICE_NAME_PREFIX="WAKEPC-"

# Matter networking.
CONFIG_LWIP_IPV6=y
CONFIG_LWIP_IPV6_AUTOCONFIG=y
CONFIG_LWIP_HOOK_IP6_ROUTE_DEFAULT=y
CONFIG_LWIP_HOOK_ND6_GET_GW_DEFAULT=y
CONFIG_LWIP_IPV6_NUM_ADDRESSES=6
CONFIG_MBEDTLS_HKDF_C=y

# Matter runtime and storage.
CONFIG_ENABLE_CHIP_SHELL=y
CONFIG_ENABLE_OTA_REQUESTOR=n
CONFIG_ESP_MATTER_MAX_DYNAMIC_ENDPOINT_COUNT=2
CONFIG_SUPPORT_GROUPCAST_CLUSTER=n

# 4 MiB layout with two OTA application slots.
CONFIG_PARTITION_TABLE_CUSTOM=y
CONFIG_PARTITION_TABLE_FILENAME="partitions.csv"
CONFIG_PARTITION_TABLE_OFFSET=0xC000

CONFIG_COMPILER_OPTIMIZATION_SIZE=y
CONFIG_LOG_DEFAULT_LEVEL_INFO=y
```
